## config/west.yml
```yaml
manifest:
  remotes:
    - name: zmkfirmware-personal
      url-base: https://github.com/Townk
    - name: zmkfirmware
      url-base: https://github.com/zmkfirmware
    - name: duanexavierbondad
      url-base: https://github.com/duanexavierbondad
    - name: rolio
      url-base: https://github.com/Townk
    - name: m165437
      url-base: https://github.com/M165437
    - name: zmk-config-totem
      url-base: https://github.com/GEIGEIGEIST/
  projects:
    - name: zephyr
      remote: zmkfirmware
      revision: v3.5.0+zmk-fixes
      clone-depth: 1
      import:
        name-blocklist:
          - ci-tools
          - hal_altera
          - hal_cypress
          - hal_infineon
          - hal_microchip
          - hal_nxp
          - hal_openisa
          - hal_silabs
          - hal_xtensa
          - hal_st
          - hal_ti
          - loramac-node
          - mcuboot
          - mcumgr
          - net-tools
          - openthread
          - edtt
          - trusted-firmware-m
    - name: zmk
      remote: zmkfirmware-personal
      revision: mousemove-molock
      clone-depth: 1
      import: app/west.yml
    - name: zmk-tri-state
      remote: duanexavierbondad
      revision: main
    - name: zmk-rolio-shield
      remote: rolio
      revision: develop
      clone-depth: 1
      path: .west/repos/zmk-rolio-shield
    - name: nice-view-gem
      remote: m165437
      revision: main
    - name: zmk-config-totem
      remote: totem
      revision: main
      clone-depth: 1
  self:
    path: config
```
